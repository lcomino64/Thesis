## Project/scpns/zephyr/zephyr_changes/boards/enjoydigital/litex_vexriscv_smp/Kconfig.defconfig
```kconfig
if BOARD_LITEX_VEXRISCV_SMP 

config BOARD
	default "litex_vexrisc_smp"

# if NETWORKING

# config NET_L2_ETHERNET
#         default y

# endif # NETWORKING
endif # BOARD_LITEX_VEXRISCV_SMP
```

## Project/scpns/zephyr/zephyr_changes/boards/enjoydigital/litex_vexriscv_smp/Kconfig.litex_vexriscv_smp
```kconfig
config BOARD_LITEX_VEXRISCV_SMP 
	select SOC_LITEX_VEXRISCV_SMP 
	# select RISCV_ISA_EXT_C
```

## Project/scpns/zephyr/zephyr_changes/boards/enjoydigital/litex_vexriscv_smp/litex_vexriscv_smp_defconfig
```kconfig
CONFIG_CONSOLE=y
CONFIG_SERIAL=y
CONFIG_UART_CONSOLE=y
CONFIG_PRINTK=y
CONFIG_SPI=y
CONFIG_GPIO=n
CONFIG_XIP=n
CONFIG_CLOCK_CONTROL=n
CONFIG_HEAP_MEM_POOL_SIZE=4096
CONFIG_INIT_STACKS=y
CONFIG_SYS_CLOCK_HW_CYCLES_PER_SEC=100000000
CONFIG_SYS_CLOCK_TICKS_PER_SEC=10000
CONFIG_MP_MAX_NUM_CPUS=2
CONFIG_SMP=y

# Make shell use polling since interrupts do not work
CONFIG_SHELL_BACKEND_SERIAL_API_POLLING=y
CONFIG_SHELL_BACKEND_SERIAL_API_INTERRUPT_DRIVEN=n
```

## Project/scpns/zephyr/zephyr_changes/soc/litex/litex_vexriscv_smp/Kconfig
```kconfig
# Copyright (c) 2018 - 2019 Antmicro <www.antmicro.com>
# SPDX-License-Identifier: Apache-2.0

config SOC_LITEX_VEXRISCV_SMP
	bool "Digilent Arty A7-35T system implementation"
	select RISCV
	select RISCV_HAS_PLIC
	select RISCV_PRIVILEGED
	select RISCV_GP
	select ATOMIC_OPERATIONS_BUILTIN
	select RISCV_ISA_RV32I
	select RISCV_ISA_EXT_M
	select RISCV_ISA_EXT_A
	select RISCV_ISA_EXT_C
	select RISCV_ISA_EXT_ZICSR
	select RISCV_ISA_EXT_ZIFENCEI
	select SMP
	select INCLUDE_RESET_VECTOR
	imply XIP


if SOC_LITEX_VEXRISCV_SMP

config LITEX_CSR_DATA_WIDTH
        int "Select Control/Status register width"
        default 32

endif # SOC_LITEX_VEXRISCV_SMP
```

## Project/scpns/zephyr/zephyr_changes/soc/litex/litex_vexriscv_smp/Kconfig.defconfig
```kconfig
if SOC_LITEX_VEXRISCV_SMP

config SMP
	default y 

config RISCV_HAS_CPU_IDLE
	bool

config RISCV_HAS_PLIC
	bool

config NUM_IRQS
    default 16

#config REBOOT
#        depends on DT_HAS_LITEX_SOC_CONTROLLER_ENABLED
#        default y

endif # SOC_LITEX_VEXRISCV_SMP
```

## Project/scpns/zephyr/zephyr_changes/soc/litex/litex_vexriscv_smp/Kconfig.soc
```kconfig
# Copyright (c) 2018 - 2019 Antmicro <www.antmicro.com>
# SPDX-License-Identifier: Apache-2.0

config SOC_LITEX_VEXRISCV_SMP
        bool
        help
          LiteX VexRiscv SMP system implementation

config SOC
        default "litex_vexriscv_smp" if SOC_LITEX_VEXRISCV_SMP
```

## Project/scpns/zephyr/zephyr_changes_sim/boards/enjoydigital/litex_vexriscv_smp/board.yml
```yaml
board:
  name: litex_vexriscv_smp
  vendor: litex
  socs:
  - name: litex_vexriscv_smp
```

## Project/scpns/zephyr/zephyr_changes_sim/boards/enjoydigital/litex_vexriscv_smp/litex_vexriscv_smp_defconfig
```kconfig
CONFIG_CONSOLE=y
CONFIG_SERIAL=y
CONFIG_UART_CONSOLE=y
CONFIG_PRINTK=y
CONFIG_GPIO=n
CONFIG_XIP=n
CONFIG_CLOCK_CONTROL=n
CONFIG_HEAP_MEM_POOL_SIZE=4096
CONFIG_INIT_STACKS=y
CONFIG_SYS_CLOCK_HW_CYCLES_PER_SEC=1000000
CONFIG_SYS_CLOCK_TICKS_PER_SEC=100
CONFIG_MP_MAX_NUM_CPUS=2
CONFIG_SMP=y
CONFIG_2ND_LEVEL_INTERRUPTS=y
```
